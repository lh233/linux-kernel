eg2805@14 {
	compatible = "eg2805,eg2805-bms";
	charge_done-gpio = <&msm_gpio 91 0x00>;
	reg = <0x14>;
	resume-soc = <98>;
};
&pm8909_bms {
	status = "okay";
	qcom,force-bms-active-on-charger;
	qcom,disable-bms;
	qcom,battery-data = <&qrd_batterydata>;
};